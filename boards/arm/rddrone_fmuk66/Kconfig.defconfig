## boards/arm/rddrone_fmuk66/Kconfig.defconfig
```kconfig
# RDDRONE-FMUK66 board

# Copyright (c) 2021, Electromaticus LLC, NXP Semiconductors
# SPDX-License-Identifier: Apache-2.0

if BOARD_RDDRONE_FMUK66

config BOARD
	default "rddrone_fmuk66"

config OSC_XTAL0_FREQ
	default 50000000

config MCG_PRDIV0
	default 0x13

config MCG_VDIV0
	default 0x18

config MCG_FCRDIV
	default 1

config TEMP_KINETIS
	default y if "$(dt_nodelabel_enabled,adc1)"
	depends on SENSOR && ADC

if NETWORKING

config NET_L2_ETHERNET
	default y if !MODEM

endif # NETWORKING

endif # BOARD_RDDRONE_FMUK66
```
